## conf/layer.conf
```bitbake
# Let bitbake find our .bbclass and .conf files
BBPATH .= ":${LAYERDIR}"

# Let bitbake know where to look for .bb and .bbappend files
BBFILES += "${LAYERDIR}/recipes-*/*/*.bb \
        ${LAYERDIR}/recipes-*/*/*.bbappend"


BBFILE_COLLECTIONS += "seco-bsp-release-imx8-ga"
BBFILE_PATTERN_seco-bsp-release-imx8-ga := "^${LAYERDIR}/"
BBFILE_PRIORITY_seco-bsp-release-imx8-ga = "6"

BBFILE_PATTERN_seco := "^${LAYERDIR}/"
BBFILE_PRIORITY_seco = "6"
```

## conf/machine/imx8mq_seco_c12.conf
```bitbake
#@TYPE: Machine
#@NAME: IMX8MQ-SECO-C12
#@SOC: i.MX8MQ
#@DESCRIPTION: Machine configuration for IMX8MQ-SECO-C12
#@MAINTAINER:Mathanraj Murugan <mathan.raj@seco.com>

MACHINEOVERRIDES =. "mx8:mx8mq:"

require conf/machine/include/imx-base.inc
require conf/machine/include/arm/arch-arm64.inc

MACHINE_FEATURES += " pci wifi bluetooth"

MACHINE_SOCARCH_FILTER_append_mx8mq = "virtual/libopenvg virtual/libgles1 virtual/libgles2 virtual/egl virtual/mesa virtual/libgl virtual/libg2d"

PREFERRED_PROVIDER_virtual/kernel ?= "linux-seco"
PREFERRED_PROVIDER_virtual/kernel_mx8mq = "linux-seco"

KERNEL_DEVICETREE = "seco/fsl-imx8mq-seco-c12.dtb"
#KERNEL_DEVICETREE += "seco/overlays/fsl-imx8mq-seco-c12-dual-display-overlay.dtbo"
#KERNEL_DEVICETREE += "seco/overlays/fsl-imx8mq-seco-c12-lcdif-sn65dsi84-overlay.dtbo"
#KERNEL_DEVICETREE += "seco/overlays/fsl-imx8mq-seco-c12-wilink-overlay.dtbo"


PREFERRED_PROVIDER_u-boot = "u-boot-seco"
PREFERRED_PROVIDER_u-boot_mx8mq = "u-boot-seco"
PREFERRED_PROVIDER_virtual/bootloader = "u-boot-seco"
PREFERRED_PROVIDER_virtual/bootloader_mx8mq = "u-boot-seco"

UBOOT_CONFIG ??= "sd"
UBOOT_CONFIG[sd] = "imx8mq_seco_c12_defconfig,sdcard"
SPL_BINARY = "spl/u-boot-spl.bin"

# Set DDR FIRMWARE
DDR_FIRMWARE_NAME = "lpddr4_pmu_train_1d_imem.bin lpddr4_pmu_train_1d_dmem.bin lpddr4_pmu_train_2d_imem.bin lpddr4_pmu_train_2d_dmem.bin"

# Set u-boot DTB
UBOOT_DTB_NAME = "fsl-imx8mq-seco-c12.dtb"

# Set imx-mkimage boot target
IMXBOOT_TARGETS = "flash_evk flash_evk_no_hdmi"


# Set Serial console
SERIAL_CONSOLE = "115200 ttymxc0"

IMAGE_BOOTLOADER = "imx-boot"

BOOT_SPACE = "32768"

LOADADDR = ""
UBOOT_SUFFIX = "bin"
UBOOT_MAKE_TARGET = ""

IMX_BOOT_SEEK = "33"
```

## conf/machine/seco-sm-qd.conf
```bitbake
#@TYPE: Machine
#@NAME: IMX8MQ-SECO-C12 SMARC board
#@SOC: i.MX8MQ QUAD
#@DESCRIPTION: Machine configuration for IMX8MQ-SECO-C12 SMARC board
#@MAINTAINER: Mathanraj Murugan <mathan.raj@seco.com>

require conf/machine/include/imx-base.inc
require conf/machine/include/arm/arch-arm64.inc

MACHINEOVERRIDES =. "mx8:mx8mq:"

MACHINE_FEATURES += " pci wifi bluetooth"

#SCMVERSION = "n"
UBOOT_CONFIG ??= "sd"
UBOOT_CONFIG[sd] = "imx8mq_seco_c12_defconfig,sdcard"
SPL_BINARY = "spl/u-boot-spl.bin"

PREFERRED_PROVIDER_u-boot = "u-boot-seco"
PREFERRED_PROVIDER_virtual/bootloader_seco-sm-qd ?= "u-boot-seco"
PREFERRED_PROVIDER_virtual/bootloader_mx8mq = "u-boot-seco"
PREFERRED_PROVIDER_virtual/bootloader = "u-boot-seco"
PREFERRED_PROVIDER_u-boot_mx8mq = "u-boot-seco"
PREFERRED_VERSION_u-boot-seco = "2017.03"


PREFERRED_PROVIDER_virtual/kernel_seco-sm-qd = "linux-seco"
PREFERRED_PROVIDER_virtual/kernel_mx8 = "linux-seco"
PREFERRED_PROVIDER_virtual/kernel_mx8mq = "linux-seco"
PREFERRED_PROVIDER_virtual/kernel = "linux-seco"
PREFERRED_VERSION_linux-seco = "4.9.51"

KERNEL_DEVICETREE ?= "seco/fsl-imx8mq-seco-c12.dtb"

DDR_FIRMWARE_NAME = "lpddr4_pmu_train_1d_imem.bin lpddr4_pmu_train_1d_dmem.bin lpddr4_pmu_train_2d_imem.bin lpddr4_pmu_train_2d_dmem.bin"

UBOOT_DTB_NAME = "fsl-imx8mq-seco-c12.dtb"

IMXBOOT_TARGETS = "flash_evk flash_evk_no_hdmi"

SERIAL_CONSOLE = "115200 ttymxc0"

IMAGE_BOOTLOADER = "imx-boot"

BOOT_SPACE = "32768"

UBOOT_SUFFIX = "bin"

UBOOT_MAKE_TARGET = ""

IMX_BOOT_SEEK = "33"

LOADADDR = ""

KERNEL_IMAGETYPE = "Image"

PREFERRED_PROVIDER_virtual/mesa = ""
```
